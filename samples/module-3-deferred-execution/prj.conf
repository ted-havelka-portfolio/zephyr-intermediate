## Kconfig
```
source "Kconfig.zephyr"

config DEBOUNCE_HANDLING
  bool "Enable kernel work rescheduling for debounce"
  default y
  help
	  "Enable kernel work rescheduling to show one way to debounce an event
	  with button press like behavior."
```

## prj.conf
```kconfig
CONFIG_LOG=y
CONFIG_THREAD_NAME=y
# l3-homework - deferred execution
CONFIG_DEBOUNCE_HANDLING=y
```

## src/main.c
```c
/*
 * Lecture 3 - Homework Starter Code
 *
 * GOAL: Convert a polling loop to an event-driven workqueue architecture.
 *
 * The starter code works but is INEFFICIENT.
 * polling_thread wakes every 10ms to check a flag.
 * sensor_sim fires every 100ms - that's 10 wasted wake-ups per event.
 *
 *
 * ================================================================
 * TASKS
 * ================================================================
 *
 * TASK 1 (starter - already works, just run it):
 *   Run the starter. Count wake-ups vs real events in the log.
 *   Expected: ~10 wake-ups per sensor event. Confirm this.
 *
 * TASK 2 (implement):
 *   Replace polling_thread with a k_work handler.
 *   sensor_sim should call k_work_submit() instead of setting a flag.
 *   The handler should do what polling_thread currently does.
 *
 *   Steps:
 *   - Define a work item with K_WORK_DEFINE
 *   - Write the handler function
 *   - In sensor_sim: call k_work_submit() (remove k_sem_give + flag)
 *   - Remove the polling_thread entirely
 *
 * TASK 3 (verify):
 *   Add k_uptime_get_32() to your handler's LOG_INF.
 *   Confirm handler runs only when sensor_sim fires (every ~100ms).
 *   No unnecessary wake-ups.
 *
 * BONUS (debounce):
 *   Change sensor_sim to fire 5 events within 20ms (not 1 per 100ms).
 *   Use k_work_reschedule with 30ms delay so only ONE handler
 *   call occurs after the burst - not 5.
 *   Log the reschedule timestamps to confirm the burst collapses.
 *
 * ================================================================
 */

#include <stdbool.h>

#include <zephyr/kernel.h>
#include <zephyr/logging/log.h>

LOG_MODULE_REGISTER(homework, LOG_LEVEL_DBG);

#define STACK_SIZE 1024
#define SENSOR_MS   100	/* sensor fires every 100ms */
#define POLL_MS	     10	/* polling consumer checks every 10ms */
#define EVENT_COUNT  10	/* total sensor events to produce */

#if CONFIG_DEBOUNCE_HANDLING
#warning "Building work rescheduling code to provide debounce feature"
#define EVENT_COUNT_TO_DEBOUNCE    5
#define SIMULATED_BOUNCE_EVENT_MS 20
#define SENSOR_WORK_DELAY_MS      30
#endif

/* ================================================================
 * STARTER CODE -- inefficient polling version
 * Run this first, then replace with workqueue in Task 2.
 * ================================================================ */

/* Statistics */
static int total_events;
static int total_wakeups;
static int total_processed;

/* ------------------------------------------------------------------ */
/*  sensor_sim - fires EVENT_COUNT events, 100ms apart                */
/* ------------------------------------------------------------------ */

void sensor_handler(struct k_work *work)
{
	ARG_UNUSED(work);
	total_processed++;
	LOG_INF("[CONSUMER] processed event %d  wakeups_so_far=%d  tick=%u",
			total_processed, total_wakeups, k_uptime_get_32());
}

#if CONFIG_DEBOUNCE_HANDLING
K_WORK_DELAYABLE_DEFINE(sensor_work, sensor_handler);
#else
K_WORK_DEFINE(sensor_work, sensor_handler);
#endif

static void sensor_sim_fn(void *p1, void *p2, void *p3)
{
#if CONFIG_DEBOUNCE_HANDLING
	int ret = k_work_schedule(&sensor_work, K_MSEC(SENSOR_WORK_DELAY_MS));
	if (ret < 0) {
		LOG_ERR("Failed to schedule simulated sensor work, err %d", ret);
		return;
	}
#endif

#if CONFIG_DEBOUNCE_HANDLING
	for (int i = 0; i < EVENT_COUNT_TO_DEBOUNCE; i++) {
		k_msleep(SIMULATED_BOUNCE_EVENT_MS);				
#else
	for (int i = 0; i < EVENT_COUNT; i++) {
		k_msleep(SENSOR_MS);
#endif

		total_events++;
		LOG_INF("[SENSOR] event %d  tick=%u", i, k_uptime_get_32());

#if CONFIG_DEBOUNCE_HANDLING
                int ret = k_work_reschedule(&sensor_work, K_MSEC(SENSOR_WORK_DELAY_MS));		
#else
		int ret = k_work_submit(&sensor_work);
#endif
		if (ret < 0) {
			LOG_ERR("submit failed, err %d", ret);
	   	}
	}

	LOG_INF("[SENSOR] done, all events produced");
}

K_THREAD_DEFINE(sensor_thread,  STACK_SIZE, sensor_sim_fn, NULL, NULL, NULL, 5, 0, 0);

/* ================================================================
 * TASK 2 PLACEHOLDER - implement your solution here
 *
 * Uncomment and fill in:
 *
 * static void sensor_handler(struct k_work *work)
 * {
 *	 ARG_UNUSED(work);
 *	 total_processed++;
 *	 LOG_INF("[HANDLER] processed event %d  tick=%u",
 *			 total_processed, k_uptime_get_32());
 * }
 *
 * K_WORK_DEFINE(sensor_work, sensor_handler);
 *
 * BONUS PLACEHOLDER - for debounce:
 *
 * K_WORK_DELAYABLE_DEFINE(debounce_work, sensor_handler);
 * In sensor_sim: k_work_reschedule(&debounce_work, K_MSEC(30));
 * ================================================================ */

int main(void)
{
	LOG_INF("=== L3 Homework: Polling to Workqueue ===");
	LOG_INF("Starter: polling disabled, simulated sensor fires every %dms",
#if CONFIG_DEBOUNCE_HANDLING
			SIMULATED_BOUNCE_EVENT_MS);
#else
			SENSOR_MS);
#endif
	LOG_INF("Expecting no wasted wakeups per event");

	/* Wait long enough for all events to complete */
	k_msleep((EVENT_COUNT + 2) * SENSOR_MS + 500);

	return 0;
}
```
