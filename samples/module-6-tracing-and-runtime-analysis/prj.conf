## Kconfig
```
# Iomico Zephyr Intermediate course - lecture 6 task

config MISSED_COUNT_INTERVAL_MS
	int "Interval on which to report missed message processing events"
	default 10000
	help
	  Interval on which to report missed message processing events.

config L6_APP_ZEPHYR_TRACING
	bool "Enable Zephyr tracing."
	select TRACING
	help
	  Enable Zephyr tracing.  To enable this symbol pulls in a handful of
	  more specific trace related symbols.  It does not pull in the symbol
	  TRACING_PACKET_MAX_SIZE, which is left to the application developer
	  to assign with some reasonable trace packet size.

config L6_APP_LOGGING
	bool "Enable Zephyr logging in the lecture 6 schedule and trace app."
	default y
	help
	  Enable Zephyr logging in the lecture 6 schedule and trace exploration
	  application.  Note that for this particular app, it was developed on
	  a small board with just one UART broken out.  This means that logging
	  necessarily disables Zephyr tracing, for sane output, and to enable
	  Zephyr trace facility disables logging.  Just for this app.
	select LOG
	depends on !L6_APP_ZEPHYR_TRACING

source "Kconfig.zephyr"
```

## prj.conf
```kconfig
# Note, Zephyr log symbol is selected in Kconfig file by choice of
# L6_APP_ZEPHYR_TRACING.
# CONFIG_LOG=y
CONFIG_LOG_MODE_DEFERRED=y
CONFIG_LOG_RATELIMIT=y
CONFIG_LOG_RATELIMIT_INTERVAL_MS=1000
CONFIG_BOOT_BANNER=n

CONFIG_MAIN_STACK_SIZE=2048

CONFIG_THREAD_NAME=y
CONFIG_THREAD_MONITOR=y

CONFIG_SHELL=y
CONFIG_KERNEL_SHELL=y
CONFIG_SHELL_BACKEND_SERIAL=y
# TODO [ ] Learn what SHELL_LOG_BACKEND provides and affects
# CONFIG_SHELL_LOG_BACKEND=n

CONFIG_INIT_STACKS=y
CONFIG_THREAD_STACK_INFO=y

CONFIG_SERIAL=y
CONFIG_CONSOLE=y
CONFIG_UART_CONSOLE=y
# TODO [ ] Learn what UART_NATIVE_PTY_0_ON_OWN_PTY provides and affects
# CONFIG_UART_NATIVE_PTY_0_ON_OWN_PTY=y

# Note, the nucleo_l432kc breaks out one UART.  We can log and trace, but not
# sensibly on one and the same UART (or other backend), so disable trace for
# logging observations, and disable logging when trace is enabled:

# Note, tracing symbol is selected in Kconfig file by choice of
# L6_APP_ZEPHYR_TRACING.
# CONFIG_TRACING=n
CONFIG_TRACING_CTF=y
CONFIG_TRACING_SYNC=y
CONFIG_TRACING_BACKEND_POSIX=y
CONFIG_TRACING_PACKET_MAX_SIZE=64

CONFIG_L6_APP_ZEPHYR_TRACING=n

CONFIG_MISSED_COUNT_INTERVAL_MS=2000
```

## nucleo_l432kc.overlay
```dts
/**
 * @brief DTS overlay for l1-task1, Iomico Zephyr Intermediate Course
 *
 * @note For STMicro's nucleo_l432, override Zephyr's chosen console UART with
 *  the UART which is broken out to pins of the dev board.  Also make sure this
 *  UART device is enabled.
 */

/ {
	chosen {
		zephyr,console = &usart1;
		zephyr,shell-uart = &usart1;
		zephyr,tracing-uart = &usart1;
	};
};

&usart1 {
	status = "okay";
};
```

## src/main.c
```c
#include <zephyr/kernel.h>
#include <zephyr/logging/log.h>
#include <zephyr/tracing/tracing.h>

LOG_MODULE_REGISTER(l6_task, LOG_LEVEL_INF);

#define STACK_SIZE            2048
#define CONTROL_PRIORITY         7
#define MAINTENANCE_PRIORITY     4
#define EVENT_PERIOD_MS        250
// #define MAINTENANCE_LOAD_US  45000
#define MAINTENANCE_LOAD_US 300000

struct control_event {
    uint32_t seq;
    uint32_t ready_ms;
};

K_MSGQ_DEFINE(control_queue, sizeof(struct control_event), 4, 4);
K_SEM_DEFINE(maintenance_start, 0, 1);

static uint32_t missed_count_fs = 0;

/* ================================================================== */
/*  Timer expiry: creates one control event                           */
/* ================================================================== */

static void event_timer_expiry(struct k_timer *timer)
{
	ARG_UNUSED(timer);

	static uint32_t seq = 1;
	struct control_event event = {
		.seq = seq++,
		.ready_ms = k_uptime_get_32(),
	};

	// Not sure whether it is safe to lock scheduler here, but trying:
	k_sched_lock();
	/* Timer expiry runs in interrupt context, so never wait here. */
	int ret = k_msgq_put(&control_queue, &event, K_NO_WAIT);

	if (ret != 0) {
		LOG_ERR("Failed message add to queue, sequence no %d",
			event.seq);
		missed_count_fs++;
		k_sched_unlock();
		return;
	}

	/* Both threads become ready when the timer interrupt returns. */
	k_sem_give(&maintenance_start);

	sys_trace_named_event("msg_ready", event.seq,
				k_msgq_num_used_get(&control_queue));

	k_sched_unlock();

	/* TODO: Add an application trace event for this sequence. */
}

K_TIMER_DEFINE(event_timer, event_timer_expiry, NULL);

static void missed_report_helper(const char* caller)
{
	static uint32_t time_previous;
	uint32_t time_present = k_uptime_get_32();
	uint32_t time_since_prev_report = time_present - time_previous;

	if (time_since_prev_report >= CONFIG_MISSED_COUNT_INTERVAL_MS) {
		LOG_INF("[%s] Missed message count %u", caller, missed_count_fs);
		time_previous = time_present;
	}
}

/* ================================================================== */
/*  Control thread                                                   */
/* ================================================================== */

static void control_fn(void *p1, void *p2, void *p3) // Begins with priority 7
{
	ARG_UNUSED(p1); ARG_UNUSED(p2); ARG_UNUSED(p3);

	while (true) {
		struct control_event event;
		int ret = k_msgq_get(&control_queue, &event, K_FOREVER);

		if (ret != 0) {
			LOG_ERR("[CONTROL] receive failed: %d", ret);
			continue;
		}

		sys_trace_named_event("msg_processed; seq, queue use", event.seq,
				k_msgq_num_used_get(&control_queue));

		uint32_t latency_ms = k_uptime_get_32() - event.ready_ms;
		sys_trace_named_event("event_done", event.seq, latency_ms);

		LOG_INF("[CONTROL] processed seq=%u, pub time %u", event.seq,
		event.ready_ms);

		uint32_t time_now = k_uptime_get_32();
		LOG_INF("[CONTROL] processed message in %d milliseconds",
		time_now - event.ready_ms);

		/* TODO: [x] Define a response-time guarantee. */
		/* TODO: [x] Measure latency and count every deadline miss. */
		/* TODO: [x] Rate-limit repeated warning messages. */
		/* TODO: [x] Add an application trace event for completion. */

		// Response-time guarantee is the sum of 
		//
		// (1) (EVENT_PERIOD_MS + MAINT_PERIOD_MS) + scheduling_time
		//
		// On a microcontroller running in the tens of megahertz,
		// scheduling time will generally be sub-millisecond.  It will
		// be greater than zero time, but is or should be at least an
		// order of magnitude smaller than the the pending and ready
		// periods.

		if (missed_count_fs > 0) {
			missed_report_helper("CONTROL");
		}

		k_msleep(5);
	}
}

/* ================================================================== */
/*  Background maintenance thread                                    */
/* ================================================================== */

static void maintenance_fn(void *p1, void *p2, void *p3) // Begins with priority 4
{
	ARG_UNUSED(p1); ARG_UNUSED(p2); ARG_UNUSED(p3);

	while (true) {
		k_sem_take(&maintenance_start, K_FOREVER);

		/* This work is important, but it has no short deadline. */
		k_busy_wait(MAINTENANCE_LOAD_US);
	}
}

K_THREAD_DEFINE(control, STACK_SIZE, control_fn,
	NULL, NULL, NULL, CONTROL_PRIORITY, 0, 0);

K_THREAD_DEFINE(maintenance, STACK_SIZE, maintenance_fn,
	NULL, NULL, NULL, MAINTENANCE_PRIORITY, 0, 0);

int main(void)
{
	LOG_INF("=== L6 Homework: Runtime Investigation ===");
	LOG_INF("Control work must start within 10 ms");
	LOG_INF("Inspect, measure, trace, explain, and correct the delay");

	k_timer_start(&event_timer, K_MSEC(500), K_MSEC(EVENT_PERIOD_MS));

	return 0;
}
```
