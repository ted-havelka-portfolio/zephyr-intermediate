## CMakeLists.txt
```
cmake_minimum_required(VERSION 3.20.0)

find_package(Zephyr REQUIRED)
project(l1_task2_shared_state)

target_sources(app PRIVATE src/main.c)
```

## Kconfig
```
# For Iomico Zephyr Intermediate course, homework 5 task 1
# (tag l5-task1)

config SUBSCRIBER_QUEUE_SIZE
	int "Size of a demonstration subscriber message queue"
	range 1 128
	default 5
	help
	  Set the size of a message subscriber queue.  Message is arbitrary data
	  not limited to printable characters.

config SENSOR_READING_COUNT
	int "Number of simulated sensor readings to publish"
	default 18
	help
	  Number of simulated sensor readings to publish on a zbus channel.

config PUBLISHER_PERIOD_MS
	int "Interval at which l5-task1 sensor data publisher emits new message"
	default 150
	help
	  Interval at which l5-task1 sensor data publisher emits new message,
	  with simulated sensor data.

config SUBSCRIBER_WDT_TIMEOUT_MS
	int "Task watchdog timeout in milliseconds, for message subscriber thread."
	default 2000
	help
	  Task watchdog timeout in milliseconds, for message subscriber thread.

config SUBSCRIBER_SIMULATED_WORK_DELAY_MS
	int "Delay added at end of l5-task1 subscriber thread, in milliseconds"
	default 100
	help
	  Delay added at end of l5-task1 subscriber thread, in milliseconds,
	  to simulate long running work.

config L5T1_QUEUE_WATERMARK
	int "Percent use of message queue, at which to warn at run time"
	default 75
	range 1 100
	help
	  Percent use of message queue at which to warn at run time, if reached.

source "Kconfig.zephyr"
```

## prj.conf
```kconfig
# This prj.conf borrowed from Iomico Zephyr Int' lecture 4, demo 2

CONFIG_LOG=y
CONFIG_ZBUS=y
CONFIG_ZBUS_MSG_SUBSCRIBER=y
CONFIG_ZBUS_MSG_SUBSCRIBER_NET_BUF_POOL_SIZE=32
CONFIG_THREAD_NAME=y

# Hardware watchdog - last line of defence
CONFIG_WATCHDOG=y . . . Zephyr does not appear to support STM32F432KC watchdog

CONFIG_WDT_LOG_LEVEL_DBG=y

# Per-thread software watchdog.  Identifies which thread is stuck.
CONFIG_TASK_WDT=y
CONFIG_TASK_WDT_HW_FALLBACK=y
CONFIG_TASK_WDT_MIN_TIMEOUT=20

# Application (l5-task1) specific
CONFIG_SENSOR_READING_COUNT=20
CONFIG_PUBLISHER_PERIOD_MS=150
CONFIG_SUBSCRIBER_WDT_TIMEOUT_MS=300
CONFIG_SUBSCRIBER_SIMULATED_WORK_DELAY_MS=600
```

## app.overlay
```dts
/**
 * @brief DTS overlay for l1-task1, Iomico Zephyr Intermediate Course
 *
 * @note For STMicro's nucleo_l432, override Zephyr's chosen console UART with
 *  the UART which is broken out to pins of the dev board.  Also make sure this
 *  UART device is enabled.
 */

/ {
	chosen {
		zephyr,console = &usart1;
		zephyr,shell-uart = &usart1;
	};
};

&usart1 {
	status = "okay";
};
```

## src/main.c
```c
/**
 * @file
 * @brief Iomico Zephyr Intermediate course, lecture 5 task 1.
 * @note Purpose: monitor queue use and apply policy when queue overflows.
 * @note Some code based on Zephyr 4.4.0 zbus "hello_world" sample.
 */

#include <zephyr/kernel.h>
#include <zephyr/logging/log.h>
#include <zephyr/sys/reboot.h>
#include <zephyr/task_wdt/task_wdt.h>
#include <zephyr/zbus/zbus.h>

LOG_MODULE_REGISTER(l5_task1, LOG_LEVEL_DBG);

#define STACK_SIZE       1024
#define SENSOR_PERIOD_MS CONFIG_PUBLISHER_PERIOD_MS

// Forward declaration
static void l5_listener_cb(const struct zbus_channel *chan);

/* ================================================================== */
/*  Shared channel message                                            */
/* ================================================================== */

struct acc_msg {
        int32_t x;
        int32_t y;
        int32_t z;
	uint32_t seq;
	uint32_t timestamp_ms;
};

ZBUS_LISTENER_DEFINE(l5_listener, l5_listener_cb);

ZBUS_SUBSCRIBER_DEFINE(l5_subscriber, CONFIG_SUBSCRIBER_QUEUE_SIZE);  // subscriber thread
					// unblocks via zbus_sub_wait(),
					// then reads message using zbus_chan_read().

ZBUS_CHAN_DEFINE(acc_data_chan,                                  /* Name */
                 struct acc_msg,                                 /* Message type */
                 NULL,                                           /* Validator */
                 NULL,                                           /* User data */
                 ZBUS_OBSERVERS(l5_listener, l5_subscriber),     /* observers */
                 ZBUS_MSG_INIT(.x = 0, .y = 0, .z = 0, .seq = 0,
			 	.timestamp_ms=0)                 /* Initial values */
);

/**
 * @note Timeout handler for task watchdog feature.
 */

struct task_timeout_context {
	uint32_t timestamp;
	char unit_of_time[8];
	char api_name[24];
};

static struct task_timeout_context task_ctx = {
	.timestamp = 0,
	.unit_of_time = "ms\0",
	.api_name = "l5-logging-fn",
};

K_SEM_DEFINE(l5t1_work_done, 0, 3);

// Provide a little more granularity for app to see when health thread done:
K_SEM_DEFINE(producer_done, 0, 1);
K_SEM_DEFINE(consumer_done, 0, 1);
K_SEM_DEFINE(p_and_c_work_done, 0, 1);
K_SEM_DEFINE(health_monitor_done, 0, 1);

//----------------------------------------------------------------------
// - SECTION - routines
//----------------------------------------------------------------------

static void task_timeout_cb(int channel_id, void* task_ctx)
{
	struct task_timeout_context* ctx = (struct task_timeout_context*)task_ctx;
#if 1
	LOG_ERR("  task watchdog channel %d for %s timed out", channel_id, ctx->api_name);
	LOG_ERR("  (Could reset here)");
#else
	sys_reboot(SYS_REBOOT_COLD);
#endif
}

//----------------------------------------------------------------------
// - Listener
//----------------------------------------------------------------------

static void l5_listener_cb(const struct zbus_channel *chan)
{
        const struct acc_msg *acc = zbus_chan_const_msg(chan);

        LOG_INF("From l5 listener -> Acc x=%d, y=%d, z=%d", acc->x, acc->y, acc->z);
}

//----------------------------------------------------------------------
// - Publisher
//----------------------------------------------------------------------

static void sensor_thread_fn(void *p1, void *p2, void *p3)
{
	ARG_UNUSED(p1); ARG_UNUSED(p2); ARG_UNUSED(p3);

	k_thread_name_set(k_current_get(), "sensor");

	for (int i = 0; i < CONFIG_SENSOR_READING_COUNT; i++) {
		struct acc_msg data = {
			.x = 10 * i,
			.y = 10 * i,
			.z = 10 * i,
			.seq = i + 1,
		};

		LOG_INF("[SENSOR] publish seq=%u accel x=%d, y=%d, z=%d",
			data.seq,
       	         data.x, data.y, data.z);

		int rc = zbus_chan_pub(&acc_data_chan, &data, K_MSEC(100));
		if (rc != 0) {
			LOG_WRN("[SENSOR] publish failed rc=%d", rc);
		}

		k_msleep(SENSOR_PERIOD_MS);
	}

	LOG_INF("* [SENSOR] done  *");

	k_sem_give(&producer_done);
}

// For l5-task1, we are going to treat this logging thread as the consumer.
// To this thread we associate a task watchdog timer.

static void logging_thread_fn(void *p1, void *p2, void *p3)
{
	ARG_UNUSED(p1); ARG_UNUSED(p2); ARG_UNUSED(p3);
	uint32_t seq_num_cur = 0;
	uint32_t seq_num_prev = 0;
	int32_t rc = 0;

	k_thread_name_set(k_current_get(), "logging-thread-l5");

	const struct zbus_channel *chan;
	int received = 0;

	// Register a channel per monitored thread
	int task_wdt_id = task_wdt_add(CONFIG_SUBSCRIBER_WDT_TIMEOUT_MS,
					task_timeout_cb,  // called if thread misses feed
					(void *)&task_ctx);

	while (received < CONFIG_SENSOR_READING_COUNT) {
		struct acc_msg msg;

		/*
		 * Message subscribers receive a copy of the published message.
		 * The logging thread will not reread the latest channel value.
		 */

		rc = zbus_sub_wait(&l5_subscriber, &chan, K_MSEC(3000));
		if (rc < 0) {
			LOG_ERR("[LOGGING] Failed or timed out waiting for zbus channel 0x%08X",
				(uint32_t)chan);
		}

		rc = zbus_chan_read(chan, &msg, K_NO_WAIT);
		if (rc < 0) {
			LOG_ERR("[LOGGING] Failed to read zbus channel for sensor reading");
		}

		received++;

		LOG_INF("[LOGGING] thread=%s seq=%u x=%d y=%d z=%d latency=%ums",
			k_thread_name_get(k_current_get()),
			msg.seq,
			msg.x, msg.y, msg.z,
			k_uptime_get_32() - msg.timestamp_ms);

		/*
		 * Slow logging thread.
		 */

		k_msleep(CONFIG_SUBSCRIBER_SIMULATED_WORK_DELAY_MS);

		seq_num_cur = msg.seq;

		if ((seq_num_cur - seq_num_prev) == 1) {
			LOG_INF("[LOGGING] sequence numbers %d, %d look good, feeding task "
				"watchdog . . .", seq_num_prev, seq_num_cur);
			task_wdt_feed(task_wdt_id);
		} else {
			LOG_ERR("[LOGGING] Sequence numbers %d, %d not consecutive!",
				seq_num_prev, seq_num_cur);
			if ((seq_num_cur - seq_num_prev) > 1) {
				LOG_WRN("[LOGGING] Detected work lost");
			} else if ((seq_num_cur - seq_num_prev) == 0) {
				LOG_WRN("[LOGGING] Queue looks empty");
			} else {
				LOG_ERR("[LOGGING] Sequence numbers swapped; at least one invalid");
			}
		}

		seq_num_prev = seq_num_cur;
	}

	LOG_INF("[LOGGING] done, received=%d messages", received);
	k_sem_give(&consumer_done);
}

static void health_thread_fn(void *p1, void *p2, void *p3)
{
	ARG_UNUSED(p1); ARG_UNUSED(p2); ARG_UNUSED(p3);
	int32_t rc = 0;

	k_thread_name_set(k_current_get(), "health-thread");

	while (1) {
		// REFERENCE https://docs.zephyrproject.org/latest/services/zbus/index.html
		uint32_t count = k_msgq_num_used_get(l5_subscriber.queue);
#if 0
		LOG_INF("- M1 - hw5 subscriber queue holds %d of %d messages",
			count, CONFIG_SUBSCRIBER_QUEUE_SIZE);
#endif
		// Log warning at 75% queue capacity
		if ((((count * 1000) / CONFIG_SUBSCRIBER_QUEUE_SIZE) / 10) >=
			CONFIG_L5T1_QUEUE_WATERMARK) {
			LOG_WRN("Queue at or over capacity of %d%%",
					CONFIG_L5T1_QUEUE_WATERMARK);
		}

		rc = k_sem_take(&p_and_c_work_done, K_NO_WAIT);
		if (rc == 0) {
			break;
		}

		k_msleep(1000);
	}

	LOG_INF("[HEALTH] Done.");
	k_sem_give(&health_monitor_done);
}

//----------------------------------------------------------------------
// - Threads
//----------------------------------------------------------------------

K_THREAD_DEFINE(sensor_thread, STACK_SIZE, sensor_thread_fn,
                NULL, NULL, NULL, 5, 0, 0);

K_THREAD_DEFINE(logging_thread_l5, STACK_SIZE, logging_thread_fn,
                NULL, NULL, NULL, 6, 0, 0);

K_THREAD_DEFINE(health_check_thread, STACK_SIZE, health_thread_fn,
                NULL, NULL, NULL, 5, 0, 0);

int main(void)
{
	LOG_INF("=== Lecture 5 task 1: Memory Resource Constraints ===");

	LOG_INF("* Sensor publishes every %d ms", SENSOR_PERIOD_MS);
	LOG_INF("* Logging thread runs a little over %d ms",
		CONFIG_SUBSCRIBER_SIMULATED_WORK_DELAY_MS);
	LOG_INF("* Display listener runs in publisher context");
	LOG_INF("* Logging thread uses message subscriber copies");
	LOG_INF("About to publish %d simulated sensor readings . . .",
		CONFIG_SENSOR_READING_COUNT);

	task_wdt_init(NULL);

	k_sem_take(&producer_done, K_FOREVER);
	LOG_INF("[MAIN] Producer thread done.");
	k_sem_take(&consumer_done, K_FOREVER);
	LOG_INF("[MAIN] Consumer thread done.");

	k_sem_give(&p_and_c_work_done);
	k_sem_take(&health_monitor_done, K_FOREVER);
	LOG_INF("[MAIN] Health thread done.");

	LOG_INF("[MAIN] Producer, consumer and health monitor all completed their work.");
	LOG_INF("[MAIN] App l5-task1 done.");
	return 0;
}
```
